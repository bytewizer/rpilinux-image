## meta-rpilinux/conf/distro/rpilinux.conf
```bitbake
DISTRO = "rpilinux"
DISTRO_NAME = "Raspberry Linux"

require conf/distro/poky.conf

# Hardware features 
MACHINE_FEATURES += "wifi bluetooth"

# Software features
DISTRO_FEATURES = "wifi bluetooth"

# Enable systemd
INIT_MANAGER = "systemd"

# Enable u-boot kernel image
RPI_USE_U_BOOT = "1"

# Set hostname
hostname:pn-base-files = "rpilinux"

# Set locale
GLIBC_GENERATE_LOCALES = "en_US.UTF-8"
IMAGE_LINGUAS = "en-us"

# Set default timezone
DEFAULT_TIMEZONE = "America/Los_Angeles"

# Set options to preserve disk space
# INHERIT += "rm_work"
# RM_WORK_EXCLUDE += "core-image-minimal"

# Set boot delay to not wait after loading GPU
BOOT_DELAY = "0"
BOOT_DELAY_MS = "0"

# Enable UART console
ENABLE_UART = "1"

# Enable I2C interface
ENABLE_I2C = "1"
KERNEL_MODULE_AUTOLOAD:rpi += "i2c-dev"

# Enable SPI interface
ENABLE_SPI_BUS = "1"

# Enable USB HOST interface
ENABLE_DWC2_HOST = "1"
```

## meta-rpilinux/conf/layer.conf
```bitbake
# We have a conf and classes directory, add to BBPATH
BBPATH .= ":${LAYERDIR}"

# We have recipes-* directories, add to BBFILES
BBFILES += "${LAYERDIR}/recipes-*/*/*.bb \
            ${LAYERDIR}/recipes-*/*/*.bbappend"

BBFILE_COLLECTIONS += "meta-rpilinux"
BBFILE_PATTERN_meta-rpilinux = "^${LAYERDIR}/"
BBFILE_PRIORITY_meta-rpilinux = "6"

LAYERDEPENDS_meta-rpilinux = "core"
LAYERSERIES_COMPAT_meta-rpilinux = "kirkstone"
```
